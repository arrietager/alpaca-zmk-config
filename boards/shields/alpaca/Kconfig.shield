## boards/shields/alpaca/Kconfig.shield
```kconfig
config SHIELD_ALPACA_LEFT
    def_bool $(shields_list_contains,alpaca_left)
  
config SHIELD_ALPACA_RIGHT
    def_bool $(shields_list_contains,alpaca_right)
  
config SHIELD_ALPACA_DONGLE
    def_bool $(shields_list_contains,alpaca_dongle)
```

## config/boards/shields/alpaca/Kconfig.defconfig
```kconfig
# Copyright (c) 2022 The ZMK Contributors
# SPDX-License-Identifier: MIT

config ZMK_BLE
    default y

config ZMK_USB
    default y

if SHIELD_ALPACA_DONGLE

config ZMK_KEYBOARD_NAME
    default "Alpaca"

config ZMK_SPLIT
    default y

config ZMK_SPLIT_ROLE_CENTRAL
    default y

endif

if SHIELD_ALPACA_LEFT || SHIELD_ALPACA_RIGHT
config ZMK_SPLIT
    default y
endif
```

## config/boards/shields/alpaca/Kconfig.shield
```kconfig
# Copyright (c) 2022 The ZMK Contributors
# SPDX-License-Identifier: MIT

config SHIELD_ALPACA_LEFT
	def_bool $(shields_list_contains,alpaca_left)

config SHIELD_ALPACA_RIGHT
	def_bool $(shields_list_contains,alpaca_right)

config SHIELD_ALPACA_DONGLE
	def_bool $(shields_list_contains,alpaca_dongle)
```
